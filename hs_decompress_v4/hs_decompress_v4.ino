// Demo Code for Heatshrink (Copyright (c) 2013-2015, Scott Vokes <vokes.s@gmail.com>)
// embedded compression library
// Craig Versek, Apr. 2016

#include <stdint.h>
#include <ctype.h>
#include <Arduino.h>
#include <String.h>

#include <heatshrink_encoder.h>
#include <heatshrink_decoder.h>
#include <greatest.h>

#define arduinoLED 13   // Arduino LED on board

/******************************************************************************/
// TEST CODE from adapted from test_heatshrink_dynamic.c
#if !HEATSHRINK_DYNAMIC_ALLOC
#error Must set HEATSHRINK_DYNAMIC_ALLOC to 1 for dynamic allocation test suite.
#endif

typedef struct {
    uint8_t log_lvl;
    uint8_t window_sz2;
    uint8_t lookahead_sz2;
    size_t decoder_input_buffer_size;
} cfg_info;

//void removeChar(char * string, char letter);
static void removeChar(char * string, char letter ) {
  for( unsigned int i = 0; i < strlen( string ); i++ )
    if( string[i] == letter )
      strcpy( string + i, string + i + 1 );
}


static void dump_buf(char *name, uint8_t *buf, uint16_t count) {
    for (int i=0; i<count; i++) {
        uint8_t c = (uint8_t)buf[i];
        printf("%s %d: 0x%02x ('%c')\n", name, i, c, isprint(c) ? c : '.');
    }
}

static void decompress_and_expand_and_check(uint8_t *input, 
                                           uint32_t input_size, 
                                           cfg_info *cfg, 
                                           uint8_t *output,
                                           uint32_t &output_size,
                                           size_t polled2) {

    Serial.print(F("\n^^ Processing\n"));
    heatshrink_decoder *hsd = heatshrink_decoder_alloc(cfg->decoder_input_buffer_size,
        cfg->window_sz2, cfg->lookahead_sz2);

    size_t compressed_size = polled2;
    size_t count  = 0;
    size_t sunk = 0;
    size_t polled = 0;
    
    if (cfg->log_lvl > 1) {
        Serial.print(F("\n^^ DECOMPRESSING\n"));
        dump_buf("comp", input, input_size);
    }
    while (sunk < compressed_size) {
        heatshrink_decoder_sink(hsd, &input[sunk], compressed_size - sunk, &count);
        sunk += count;
        if (cfg->log_lvl > 1){
          Serial.print(F("^^ sunk "));
          Serial.print(count);
          Serial.print(F("\n"));
        }
        if (sunk == compressed_size) {
            heatshrink_decoder_finish(hsd);
        }

        HSD_poll_res pres;
        do {
            pres = heatshrink_decoder_poll(hsd, &output[polled],
                output_size - polled, &count);
            polled += count;
            if (cfg->log_lvl > 1){
              Serial.print(F("^^ polled "));
              Serial.print(count);
              Serial.print(F("\n"));
            }
        } while (pres == HSDR_POLL_MORE);
        if (sunk == compressed_size) {
            HSD_finish_res fres = heatshrink_decoder_finish(hsd);
        }

        if (polled > input_size) {
            Serial.print(F("nExpected "));
            Serial.print((size_t)input_size);
            Serial.print(F(" got: "));
            Serial.print(polled);
            Serial.print(F(" \n")); 
            Serial.print(F("FAIL: Decompressed data is larger than original input!"));
        }
    }
   
    if (polled != input_size) {
        Serial.print(F("polled: "));
        Serial.print(polled);
        Serial.print(F(" \n")); 
        Serial.print(F("input size: "));
        Serial.print(input_size);
        Serial.print(F(" \n")); 
        Serial.print(F("FAIL: Decompressed length does not match original input length!"));
    }

    if (cfg->log_lvl > 1) dump_buf("decomp", output, output_size);
    //compare hasil decompressi dengan data raw
//    for (uint32_t i=0; i<input_size; i++) {
//        if (input[i] != output[i]) {
//            Serial.print(F("*** mismatch at: "));
//            Serial.print(i);
//            Serial.print(F(" \n"));
//        }
//    }

     if (cfg->log_lvl > 0){
        Serial.print(F("in: "));
        Serial.print(compressed_size);
        Serial.print(F(" decompressed: "));
        Serial.print(polled);
        Serial.print(F(" \n")); 

        Serial.print("Decompressed data: ");
        for(int i = 0; i < polled; i++){
          Serial.print(output[i]);
          Serial.print(", ");
        }Serial.println();
    }
}



/******************************************************************************/
#define BUFFER_SIZE 1400
uint8_t decomp_buffer[BUFFER_SIZE];

int main(int argc, char **argv)
{
    init(); // this is needed

    pinMode(arduinoLED, OUTPUT);      // Configure the onboard LED for output
    digitalWrite(arduinoLED, LOW);    // default to LED off
    Serial.begin(9600);

    uint32_t decomp_size = BUFFER_SIZE; //this will get updated by reference
    uint8_t orig_char[BUFFER_SIZE];
    size_t polled = 0;
    
    ///////////////////////////////////////////////////////////////////////////////////////////
    /////////////////////////////Test Decompression////////////////////////////////////////////
    
//    uint8_t orig_angka [] = {158, 75, 236, 150, 155, 180, 248, 11, 128, 138, 65, 105, 178,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 143, 0};
//
//    uint8_t orig_angka [] = {158, 75, 236, 150, 155, 180, 248, 10, 192, 66, 144, 90, 108,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 240, 0};
//    
//    uint8_t orig_angka [] = {158, 75, 236, 150, 155, 180, 248, 10, 96, 32, 164, 22, 155,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 248, 0};
//
//   uint8_t orig_angka [] = {158, 75, 236, 150, 155, 180, 248, 10, 48, 16, 41, 5, 166,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 192, 0};
//
    uint8_t orig_angka [] = {158, 75, 236, 150, 155, 180, 248, 10, 24, 8, 10, 65, 105,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 190, 0};

    
    int comp_size = sizeof(orig_angka)/sizeof(orig_angka[0]);
    Serial.print("length_angka : ");
    Serial.println(comp_size);
    
    int length_data_ori = 1345;
    polled = comp_size;
    cfg_info cfg;
    cfg.log_lvl = 0;
    cfg.window_sz2 = 8;
    cfg.lookahead_sz2 = 7;
    cfg.decoder_input_buffer_size = 64;
    uint32_t t2 = micros();
    decompress_and_expand_and_check(orig_angka, length_data_ori, &cfg, decomp_buffer, decomp_size, polled);
    uint32_t t3 = micros();
    Serial.print("Time to decompress: ");
    Serial.println((t3-t2)/1e6,6);
    //////////////////////////////////////////////////////////////////////////////////////////////////////////

    
    for ( ;; )
    {
      delay(3000);
    }   
}



