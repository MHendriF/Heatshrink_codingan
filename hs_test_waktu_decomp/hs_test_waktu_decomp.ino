// Demo Code for Heatshrink (Copyright (c) 2013-2015, Scott Vokes <vokes.s@gmail.com>)
// embedded compression library
// Craig Versek, Apr. 2016

#include <stdint.h>
#include <ctype.h>
#include <Arduino.h>
#include <String.h>

#include <heatshrink_encoder.h>
#include <heatshrink_decoder.h>
#include <greatest.h>

#define arduinoLED 13   // Arduino LED on board

/******************************************************************************/
// TEST CODE from adapted from test_heatshrink_dynamic.c
#if !HEATSHRINK_DYNAMIC_ALLOC
#error Must set HEATSHRINK_DYNAMIC_ALLOC to 1 for dynamic allocation test suite.
#endif

typedef struct {
    uint8_t log_lvl;
    uint8_t window_sz2;
    uint8_t lookahead_sz2;
    size_t decoder_input_buffer_size;
} cfg_info;


static void dump_buf(char *name, uint8_t *buf, uint16_t count) {
    for (int i=0; i<count; i++) {
        uint8_t c = (uint8_t)buf[i];
        printf("%s %d: 0x%02x ('%c')\n", name, i, c, isprint(c) ? c : '.');
    }
}

static void decompress_and_expand_and_check(uint8_t *comp, uint32_t input_size, cfg_info *cfg, size_t polled2) {

    Serial.print(F("\n^^ Processing\n"));
    heatshrink_decoder *hsd = heatshrink_decoder_alloc(cfg->decoder_input_buffer_size,
        cfg->window_sz2, cfg->lookahead_sz2);

    size_t decomp_sz = input_size + (input_size/10) + 4;
    uint8_t *decomp = (uint8_t*)malloc(decomp_sz);
    if (decomp == NULL) 
      Serial.println(F("FAIL: Malloc fail!"));
    memset(decomp, 0, decomp_sz);
    
    size_t compressed_size = polled2;
    size_t count  = polled2;
    size_t sunk = 0;
    size_t polled = 0;
    
    if (cfg->log_lvl > 1) {
        Serial.print(F("\n^^ DECOMPRESSING\n"));
        dump_buf("comp", comp, compressed_size);
    }
    while (sunk < compressed_size) {
        heatshrink_decoder_sink(hsd, &comp[sunk], compressed_size - sunk, &count);
        sunk += count;
        if (cfg->log_lvl > 1){
          Serial.print(F("^^ sunk "));
          Serial.print(count);
          Serial.print(F("\n"));
        }
        if (sunk == compressed_size) {
            heatshrink_decoder_finish(hsd);
        }

        HSD_poll_res pres;
        do {
            pres = heatshrink_decoder_poll(hsd, &decomp[polled], decomp_sz - polled, &count);
            polled += count;
            if (cfg->log_lvl > 1){
              Serial.print(F("^^ polled "));
              Serial.print(count);
              Serial.print(F("\n"));
            }
        } while (pres == HSDR_POLL_MORE);
        if (sunk == compressed_size) {
            HSD_finish_res fres = heatshrink_decoder_finish(hsd);
        }

        if (polled > input_size) {
            Serial.print(F("nExpected "));
            Serial.print((size_t)input_size);
            Serial.print(F(" got: "));
            Serial.print(polled);
            Serial.print(F(" \n")); 
            Serial.print(F("FAIL: Decompressed data is larger than original input!"));
        }
    }
   
    if (polled != input_size) {
        Serial.print(F("polled: "));
        Serial.print(polled);
        Serial.print(F(" \n")); 
        Serial.print(F("input size: "));
        Serial.print(input_size);
        Serial.print(F(" \n")); 
        Serial.print(F("FAIL: Decompressed length does not match original input length!"));
    }

    if (cfg->log_lvl > 1) dump_buf("decomp", decomp, polled);

    if (cfg->log_lvl > 0){
        Serial.print(F("in: "));
        Serial.print(compressed_size);
        Serial.print(F(" decompressed: "));
        Serial.print(polled);
        Serial.print(F(" \n")); 

        Serial.print("Decompressed data: ");
        for(int i = 0; i < polled; i++){
          Serial.print(decomp[i]);
          Serial.print(", ");
        }
        Serial.println();
    }

    free(decomp);
    heatshrink_decoder_free(hsd);
}



/******************************************************************************/

int main(int argc, char **argv)
{
    init(); // this is needed

    pinMode(arduinoLED, OUTPUT);      // Configure the onboard LED for output
    digitalWrite(arduinoLED, LOW);    // default to LED off
    Serial.begin(9600);
    size_t polled = 0;
    
    ///////////////////////////////////////////////////////////////////////////////////////////
    /////////////////////////////Test Decompression////////////////////////////////////////////

    //////////////////////////584
//    uint8_t orig_angka [] = {152, 131, 131, 131, 131, 131, 131, 131, 131, 131, 131, 131, 131,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 192, 0};
//    uint8_t orig_angka [] = {158, 75, 236, 150, 155, 180, 248, 184, 138, 65, 105, 178, 79,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 192, 0};

//    uint8_t orig_angka [] = {158, 75, 236, 150, 155, 180, 248, 5, 6, 1, 0, 164, 22,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 202, 0};

    uint8_t orig_angka [] =  {158, 75, 236, 150, 155, 180, 248, 20, 96, 64, 164, 22, 155,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 158, 0};

//    uint8_t orig_angka [] =  {158, 75, 236, 150, 155, 180, 248, 10, 24, 8, 10, 65, 105,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 128, 0};
    
    int comp_size = sizeof(orig_angka)/sizeof(orig_angka[0]);
    Serial.print("length_angka : ");
    Serial.println(comp_size);
    
    int input_size = 1640;
    polled = comp_size;
    cfg_info cfg;
    cfg.log_lvl = 1;
    cfg.window_sz2 = 7;
    cfg.lookahead_sz2 = 6;
    cfg.decoder_input_buffer_size = 64;
    uint32_t t2 = micros();
    decompress_and_expand_and_check(orig_angka, input_size, &cfg, polled);
    uint32_t t3 = micros();
    Serial.print("Time to decompress: ");
    Serial.println((t3-t2)/1e6,6);
    //////////////////////////////////////////////////////////////////////////////////////////////////////////
    
    for ( ;; )
    {
      delay(3000);
    }   
}



